## arch/arm/mach-msm/htc/Kconfig.board
```kconfig
#
# Include the specific Kconfig file for HTC board
#

# ELITE
source "arch/arm/mach-msm/htc/elite/Kconfig"

# FIGHTER
source "arch/arm/mach-msm/htc/fighter/Kconfig"

# JET
source "arch/arm/mach-msm/htc/jet/Kconfig"

# VILLE
source "arch/arm/mach-msm/htc/ville/Kconfig"

# M7
source "arch/arm/mach-msm/htc/m7/Kconfig"

# VALENTE_WX
source "arch/arm/mach-msm/htc/valente_wx/Kconfig"

# M7_WLJ
source "arch/arm/mach-msm/htc/m7wlj/Kconfig"

# T6
source "arch/arm/mach-msm/htc/t6/Kconfig"

# M4
source "arch/arm/mach-msm/htc/m4/Kconfig"

config MACH_HTC_DUMMY
	bool "NONE (No device)"
```

## arch/arm/mach-msm/htc/valente_wx/Kconfig
```kconfig
config BOARD_HEADER_FILE
	string "HTC board specific header file name"
	default ""

config MACH_VALENTE_WX
	depends on ARCH_MSM8960
	select MACH_HTC
	bool "HTC Valente WX"
	help
	  Support for the HTC VALENTE_WX device.
```
